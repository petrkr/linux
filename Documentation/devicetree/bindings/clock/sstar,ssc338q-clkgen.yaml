## Documentation/devicetree/bindings/pinctrl/sstar,ssc338q-pinctrl.yaml
```yaml
# SPDX-License-Identifier: (GPL-2.0-only OR BSD-2-Clause)
%YAML 1.2
---
$id: http://devicetree.org/schemas/pinctrl/sstar,ssc338q-pinctrl.yaml#
$schema: http://devicetree.org/meta-schemas/core.yaml#

title: SigmaStar SSC338Q pin controller

maintainers:
  - Petr Kracik <petrkr@petrkr.net>

description: |
  The PADTOP block of the SigmaStar SSC338Q (Infinity6E) has one register
  per pad holding its GPIO state and configuration. The function muxes are
  spread over PADTOP, CHIPTOP and the PM sleep block. The PM pads have the
  same kind of registers in the PM GPIO block, the pads of the SAR ADC are
  controlled in the SAR block.

  The GPIO numbers are defined in include/dt-bindings/gpio/sstar,ssc338q-gpio.h.

properties:
  compatible:
    const: sstar,ssc338q-pinctrl

  reg:
    items:
      - description: PADTOP registers
      - description: PM GPIO registers

  gpio-controller: true

  gpio-line-names:
    maxItems: 107

  "#gpio-cells":
    const: 2

  sstar,chiptop:
    $ref: /schemas/types.yaml#/definitions/phandle
    description: The CHIPTOP system controller.

  sstar,pmsleep:
    $ref: /schemas/types.yaml#/definitions/phandle
    description: The PM sleep system controller.

  sstar,sar:
    $ref: /schemas/types.yaml#/definitions/phandle
    description: The SAR ADC, which holds the mode and GPIO state of its pads.

patternProperties:
  "-state$":
    type: object
    additionalProperties: false

    patternProperties:
      "-pins$":
        type: object
        $ref: /schemas/pinctrl/pincfg-node.yaml#
        allOf:
          - $ref: /schemas/pinctrl/pinmux-node.yaml#

        properties:
          groups:
            items:
              enum: [sd0, sd0_cdz, pm_spi, pm_led, i2c0, sar0, sar1, sar2,
                     sar3, i2c1, uart1_gpio0, uart1_i2s0, uart1_eth_led,
                     uart1_gpio4, uart1_fuart, uart1_gpio8, fuart, sr0_mipi,
                     sr0_ctrl, sr0_pdn]

          function:
            enum: [gpio, sd0, sd0_cdz, pm_spi, eth_led, i2c0, adc, i2c1,
                    uart1, fuart, sr0_mipi, sr0_ctrl, sr0_pdn]

          pins:
            items:
              enum:
                - GPIO0
                - GPIO1
                - GPIO2
                - GPIO3
                - GPIO4
                - GPIO5
                - GPIO6
                - GPIO7
                - GPIO8
                - GPIO9
                - GPIO10
                - GPIO11
                - GPIO12
                - GPIO13
                - GPIO14
                - GPIO15
                - SD0_GPIO0
                - SD0_CDZ
                - SD0_D1
                - SD0_D0
                - SD0_CLK
                - SD0_CMD
                - SD0_D3
                - SD0_D2
                - I2S0_MCLK
                - I2S0_BCK
                - I2S0_WCK
                - I2S0_DI
                - I2S0_DO
                - I2C0_SCL
                - I2C0_SDA
                - ETH_LED0
                - ETH_LED1
                - FUART_RX
                - FUART_TX
                - FUART_CTS
                - FUART_RTS
                - SD1_CDZ
                - SD1_D1
                - SD1_D0
                - SD1_CLK
                - SD1_CMD
                - SD1_D3
                - SD1_D2
                - SD1_GPIO0
                - SD1_GPIO1
                - SPI_CZ
                - SPI_CK
                - SPI_DI
                - SPI_DO
                - SPI_WPZ
                - SPI_HLD
                - SR0_IO00
                - SR0_IO01
                - SR0_IO02
                - SR0_IO03
                - SR0_IO04
                - SR0_IO05
                - SR0_IO06
                - SR0_IO07
                - SR0_IO08
                - SR0_IO09
                - SR0_IO10
                - SR0_IO11
                - SR0_IO12
                - SR0_IO13
                - SR0_IO14
                - SR0_IO15
                - SR0_IO16
                - SR0_IO17
                - SR0_IO18
                - SR0_IO19
                - SR1_IO00
                - SR1_IO01
                - SR1_IO02
                - SR1_IO03
                - SR1_IO04
                - SR1_IO05
                - SR1_IO06
                - SR1_IO07
                - SR1_IO08
                - SR1_IO09
                - SR1_IO10
                - SR1_IO11
                - SR1_IO12
                - SR1_IO13
                - SR1_IO14
                - SR1_IO15
                - SR1_IO16
                - SR1_IO17
                - SR1_IO18
                - SR1_IO19
                - PM_GPIO0
                - PM_GPIO1
                - PM_GPIO2
                - PM_GPIO3
                - PM_GPIO4
                - PM_GPIO5
                - PM_GPIO6
                - PM_GPIO7
                - PM_GPIO8
                - PM_GPIO9
                - PM_GPIO10
                - SAR_GPIO0
                - SAR_GPIO1
                - SAR_GPIO2
                - SAR_GPIO3

          bias-disable: true
          bias-pull-up: true
          input-enable: true
          output-low: true
          output-high: true

        additionalProperties: false

required:
  - compatible
  - reg
  - gpio-controller
  - "#gpio-cells"
  - sstar,chiptop
  - sstar,pmsleep
  - sstar,sar

allOf:
  - $ref: pinctrl.yaml#

additionalProperties: false

examples:
  - |
    pinctrl@207800 {
        compatible = "sstar,ssc338q-pinctrl";
        reg = <0x207800 0x200>, <0x7e00 0x100>;
        gpio-controller;
        #gpio-cells = <2>;
        sstar,chiptop = <&chiptop>;
        sstar,pmsleep = <&pmsleep>;
        sstar,sar = <&sar>;

        sd0-default-state {
            sd0-pins {
                groups = "sd0";
                function = "sd0";
            };

            sd0-data-pins {
                pins = "SD0_D0", "SD0_D1", "SD0_D2", "SD0_D3", "SD0_CMD";
                bias-pull-up;
                input-enable;
            };
        };
    };
```

## Documentation/devicetree/bindings/pwm/sstar,ssc338q-pwm.yaml
```yaml
# SPDX-License-Identifier: (GPL-2.0-only OR BSD-2-Clause)
%YAML 1.2
---
$id: http://devicetree.org/schemas/pwm/sstar,ssc338q-pwm.yaml#
$schema: http://devicetree.org/meta-schemas/core.yaml#

title: SigmaStar SSC338Q PWM controller

maintainers:
  - Petr Kracik <petrkr@petrkr.net>

allOf:
  - $ref: pwm.yaml#

properties:
  compatible:
    const: sstar,ssc338q-pwm

  reg:
    maxItems: 1

  clocks:
    maxItems: 1

  "#pwm-cells":
    const: 3

required:
  - compatible
  - reg
  - clocks

unevaluatedProperties: false

examples:
  - |
    #include <dt-bindings/clock/sstar,ssc338q-clkgen.h>

    pwm@203200 {
        compatible = "sstar,ssc338q-pwm";
        reg = <0x203200 0x400>;
        clocks = <&clkgen SSC338Q_CLKGEN_PWM>;
        #pwm-cells = <3>;
    };
```

## Documentation/devicetree/bindings/rng/sstar,ssc338q-rng.yaml
```yaml
# SPDX-License-Identifier: (GPL-2.0-only OR BSD-2-Clause)
%YAML 1.2
---
$id: http://devicetree.org/schemas/rng/sstar,ssc338q-rng.yaml#
$schema: http://devicetree.org/meta-schemas/core.yaml#

title: SigmaStar SSC338Q random number generator

maintainers:
  - Petr Kracik <petrkr@petrkr.net>

description:
  Hardware random number generator in the crypto engine (AESDMA) register
  block of the SigmaStar SSC338Q (Infinity6E) SoC.

properties:
  compatible:
    const: sstar,ssc338q-rng

  reg:
    maxItems: 1

  clocks:
    maxItems: 1

required:
  - compatible
  - reg
  - clocks

additionalProperties: false

examples:
  - |
    #include <dt-bindings/clock/sstar,ssc338q-clkgen.h>

    rng@224400 {
        compatible = "sstar,ssc338q-rng";
        reg = <0x224400 0x10>;
        clocks = <&clkgen SSC338Q_CLKGEN_AESDMA>;
    };
```

## Documentation/devicetree/bindings/sound/sstar,ssc338q-bach.yaml
```yaml
# SPDX-License-Identifier: (GPL-2.0-only OR BSD-2-Clause)
%YAML 1.2
---
$id: http://devicetree.org/schemas/sound/sstar,ssc338q-bach.yaml#
$schema: http://devicetree.org/meta-schemas/core.yaml#

title: SigmaStar SSC338Q audio controller

maintainers:
  - Petr Kracik <petrkr@petrkr.net>

description:
  Audio block (BACH) of the SigmaStar SSC338Q (Infinity6E) SoC with its
  analog front end (ATOP). BACH holds the digital audio path and a DMA
  engine, ATOP the microphone amplifiers, the ADC and the DAC.

properties:
  compatible:
    const: sstar,ssc338q-bach

  reg:
    items:
      - description: BACH registers
      - description: ATOP registers

  reg-names:
    items:
      - const: bach
      - const: atop

  interrupts:
    maxItems: 1

  clocks:
    maxItems: 1

required:
  - compatible
  - reg
  - reg-names
  - interrupts
  - clocks

additionalProperties: false

examples:
  - |
    #include <dt-bindings/clock/sstar,ssc338q-clkgen.h>
    #include <dt-bindings/interrupt-controller/arm-gic.h>

    audio-controller@2a0400 {
        compatible = "sstar,ssc338q-bach";
        reg = <0x2a0400 0x600>, <0x206800 0x200>;
        reg-names = "bach", "atop";
        interrupts = <GIC_SPI 42 IRQ_TYPE_LEVEL_HIGH>;
        clocks = <&clkgen SSC338Q_CLKGEN_BACH>;
    };
```

## Documentation/devicetree/bindings/spi/sstar,ssc338q-fsp.yaml
```yaml
# SPDX-License-Identifier: (GPL-2.0-only OR BSD-2-Clause)
%YAML 1.2
---
$id: http://devicetree.org/schemas/spi/sstar,ssc338q-fsp.yaml#
$schema: http://devicetree.org/meta-schemas/core.yaml#

title: SigmaStar SSC338Q FSP SPI flash controller

maintainers:
  - Petr Kracik <petrkr@petrkr.net>

description:
  The FSP (flash serial peripheral) of the SigmaStar SSC338Q (Infinity6E)
  SoC executes short SPI flash commands. The register region also covers
  the QSPI block that follows it, which reads the flash for the BDMA
  controller. The FSP can take the data it sends from the BDMA.

allOf:
  - $ref: spi-controller.yaml#

properties:
  compatible:
    const: sstar,ssc338q-fsp

  reg:
    maxItems: 1

  clocks:
    maxItems: 1

  dmas:
    items:
      - description: BDMA channel reading the flash through the QSPI block
      - description: BDMA channel feeding the FSP write buffer

  dma-names:
    items:
      - const: rx
      - const: tx

required:
  - compatible
  - reg
  - clocks

unevaluatedProperties: false

examples:
  - |
    #include <dt-bindings/clock/sstar,ssc338q-clkgen.h>

    spi@201a00 {
        compatible = "sstar,ssc338q-fsp";
        reg = <0x201a00 0x400>;
        clocks = <&clkgen SSC338Q_CLKGEN_SPI_FLASH>;
        dmas = <&bdma 0 5>, <&bdma 1 11>;
        dma-names = "rx", "tx";
        #address-cells = <1>;
        #size-cells = <0>;

        flash@0 {
            compatible = "spi-nand";
            reg = <0>;
        };
    };
```

## Documentation/devicetree/bindings/usb/sstar,ssc338q-ehci.yaml
```yaml
# SPDX-License-Identifier: (GPL-2.0-only OR BSD-2-Clause)
%YAML 1.2
---
$id: http://devicetree.org/schemas/usb/sstar,ssc338q-ehci.yaml#
$schema: http://devicetree.org/meta-schemas/core.yaml#

title: SigmaStar SSC338Q USB 2.0 host controller

maintainers:
  - Petr Kracik <petrkr@petrkr.net>

description:
  Faraday FUSBH200 EHCI-like host controller with an integrated
  transaction translator. Each 32-bit register is accessed as two 16-bit
  halves on the RIU bus. A second register block configures the
  controller and its connection to the PHY.

allOf:
  - $ref: usb-hcd.yaml#

properties:
  compatible:
    const: sstar,ssc338q-ehci

  reg:
    items:
      - description: Host controller registers
      - description: USB controller configuration registers

  reg-names:
    items:
      - const: uhc
      - const: usbc

  interrupts:
    maxItems: 1

  phys:
    maxItems: 1

  phy-names:
    const: usb

  vbus-supply:
    description: Regulator for the VBUS of the port

required:
  - compatible
  - reg
  - reg-names
  - interrupts
  - phys
  - phy-names

unevaluatedProperties: false

examples:
  - |
    #include <dt-bindings/interrupt-controller/arm-gic.h>

    usb@284800 {
        compatible = "sstar,ssc338q-ehci";
        reg = <0x284800 0x200>, <0x284600 0x200>;
        reg-names = "uhc", "usbc";
        interrupts-extended = <&intc_irq GIC_SPI 31 IRQ_TYPE_LEVEL_HIGH>;
        phys = <&usb_phy>;
        phy-names = "usb";
    };
```

## drivers/clk/mstar/Kconfig
```kconfig
# SPDX-License-Identifier: GPL-2.0-only
config MSTAR_MSC313_CPUPLL
	bool "MStar CPUPLL driver"
	depends on ARCH_MSTARV7 || COMPILE_TEST
	default ARCH_MSTARV7
	help
	  Support for the CPU PLL present on MStar/Sigmastar SoCs.

config MSTAR_MSC313_MPLL
	bool "MStar MPLL driver"
	depends on ARCH_MSTARV7 || COMPILE_TEST
	default ARCH_MSTARV7
	select REGMAP_MMIO
	help
	  Support for the MPLL PLL and dividers block present on
	  MStar/Sigmastar SoCs.

config SSTAR_SSC338Q_CLKGEN
	bool "SigmaStar SSC338Q clock generator driver"
	depends on ARCH_MSTARV7 || COMPILE_TEST
	default ARCH_MSTARV7
	help
	  Support for the clock generator of the SigmaStar SSC338Q
	  (Infinity6E) SoC. It selects the parent of the peripheral
	  clocks from the MPLL outputs or the crystal and gates them,
	  together with the Ethernet MAC clock gates of the SC_GP block.
```

## sound/soc/sstar/Kconfig
```kconfig
# SPDX-License-Identifier: GPL-2.0-only
menu "SigmaStar"

config SND_SOC_SSTAR_BACH
	tristate "SigmaStar SSC338Q audio capture"
	depends on ARCH_MSTARV7 || COMPILE_TEST
	depends on HAS_IOMEM && COMMON_CLK
	help
	  Say Y or M to record from the analog microphone input of the
	  SigmaStar SSC338Q (Infinity6E) SoC.

	  To compile this driver as a module, choose M here: the module
	  will be called snd-soc-sstar-bach.

endmenu
```
