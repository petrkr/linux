## Documentation/devicetree/bindings/clock/sstar,ssc338q-clkgen.yaml
```yaml
# SPDX-License-Identifier: (GPL-2.0-only OR BSD-2-Clause)
%YAML 1.2
---
$id: http://devicetree.org/schemas/clock/sstar,ssc338q-clkgen.yaml#
$schema: http://devicetree.org/meta-schemas/core.yaml#

title: SigmaStar SSC338Q clock generator

maintainers:
  - Petr Kracik <petrkr@petrkr.net>

description: |
  The clock generator (CLKGEN) of the SigmaStar SSC338Q (Infinity6E) selects
  the parent clock of each peripheral from the MPLL outputs, the USB PLL
  and UTMI PLL outputs or the crystal and gates it. A few more peripheral clocks, such as the Ethernet MAC RX
  and TX clocks, are gated in the SC_GP control block.

  See include/dt-bindings/clock/sstar,ssc338q-clkgen.h for the clock IDs.

properties:
  compatible:
    enum:
      - sstar,ssc338q-clkgen
      - sstar,ssc338q-scgp

  reg:
    maxItems: 1

  "#clock-cells":
    const: 1

  clocks:
    items:
      - description: MPLL output divided by 5
      - description: MPLL output divided by 6
      - description: MPLL output divided by 7
      - description: MPLL output divided by 10
      - description: Crystal divided by 2
      - description: MPLL output divided by 2
      - description: MPLL output divided by 3
      - description: MPLL output divided by 4
      - description: Crystal
      - description: USB PLL 384 MHz output
      - description: USB PLL 320 MHz output
      - description: UTMI PLL 480 MHz output
      - description: UTMI PLL 240 MHz output
      - description: UTMI PLL 192 MHz output
      - description: UTMI PLL 160 MHz output
      - description: MPLL output multiplied by 2/5

  clock-names:
    items:
      - const: mpll-div5
      - const: mpll-div6
      - const: mpll-div7
      - const: mpll-div10
      - const: xtal-div2
      - const: mpll-div2
      - const: mpll-div3
      - const: mpll-div4
      - const: xtal
      - const: upll-384m
      - const: upll-320m
      - const: utmi-480m
      - const: utmi-240m
      - const: utmi-192m
      - const: utmi-160m
      - const: mpll-345m

required:
  - compatible
  - reg
  - "#clock-cells"

allOf:
  - if:
      properties:
        compatible:
          const: sstar,ssc338q-clkgen
    then:
      required:
        - clocks
        - clock-names
    else:
      properties:
        clocks: false
        clock-names: false

additionalProperties: false

examples:
  - |
    #include <dt-bindings/clock/mstar-msc313-mpll.h>

    clock-controller@207000 {
        compatible = "sstar,ssc338q-clkgen";
        reg = <0x207000 0x200>;
        #clock-cells = <1>;
        clocks = <&mpll MSTAR_MSC313_MPLL_DIV5>,
                 <&mpll MSTAR_MSC313_MPLL_DIV6>,
                 <&mpll MSTAR_MSC313_MPLL_DIV7>,
                 <&mpll MSTAR_MSC313_MPLL_DIV10>,
                 <&xtal_div2>,
                 <&mpll MSTAR_MSC313_MPLL_DIV2>,
                 <&mpll MSTAR_MSC313_MPLL_DIV3>,
                 <&mpll MSTAR_MSC313_MPLL_DIV4>,
                 <&xtal>,
                 <&upll_384m>,
                 <&upll_320m>,
                 <&utmi_480m>,
                 <&utmi_240m>,
                 <&utmi_192m>,
                 <&utmi_160m>,
                 <&mpll_345m>;
        clock-names = "mpll-div5", "mpll-div6", "mpll-div7",
                      "mpll-div10", "xtal-div2", "mpll-div2",
                      "mpll-div3", "mpll-div4", "xtal",
                      "upll-384m", "upll-320m", "utmi-480m",
                      "utmi-240m", "utmi-192m", "utmi-160m",
                      "mpll-345m";
    };

  - |
    clock-controller@226600 {
        compatible = "sstar,ssc338q-scgp";
        reg = <0x226600 0x200>;
        #clock-cells = <1>;
    };
```

## Documentation/devicetree/bindings/dma/sstar,ssc338q-bdma.yaml
```yaml
# SPDX-License-Identifier: (GPL-2.0-only OR BSD-2-Clause)
%YAML 1.2
---
$id: http://devicetree.org/schemas/dma/sstar,ssc338q-bdma.yaml#
$schema: http://devicetree.org/meta-schemas/core.yaml#

title: SigmaStar SSC338Q BDMA controller

maintainers:
  - Petr Kracik <petrkr@petrkr.net>

description:
  General purpose DMA controller (BDMA) of the SigmaStar SSC338Q
  (Infinity6E) SoC. It has four channels, each with its own interrupt,
  that copy or fill memory, optionally line by line with a line offset,
  and move data between memory and some peripherals.

allOf:
  - $ref: dma-controller.yaml#

properties:
  compatible:
    const: sstar,ssc338q-bdma

  reg:
    maxItems: 1

  interrupts:
    items:
      - description: channel 0
      - description: channel 1
      - description: channel 2
      - description: channel 3

  clocks:
    maxItems: 1

  "#dma-cells":
    const: 2
    description: |
      The first cell is the channel number. The second cell selects the
      peripheral on the device side of the transfer, it is the value of the
      source or destination selection of the controller, for example 5 for
      the read path of the SPI flash controller and 11 for the write buffer
      of its FSP.

required:
  - compatible
  - reg
  - interrupts
  - clocks
  - "#dma-cells"

unevaluatedProperties: false

examples:
  - |
    #include <dt-bindings/clock/sstar,ssc338q-clkgen.h>
    #include <dt-bindings/interrupt-controller/arm-gic.h>

    dma-controller@200400 {
        compatible = "sstar,ssc338q-bdma";
        reg = <0x200400 0x200>;
        interrupts = <GIC_SPI 40 IRQ_TYPE_LEVEL_HIGH>,
                     <GIC_SPI 41 IRQ_TYPE_LEVEL_HIGH>,
                     <GIC_SPI 61 IRQ_TYPE_LEVEL_HIGH>,
                     <GIC_SPI 62 IRQ_TYPE_LEVEL_HIGH>;
        clocks = <&clkgen SSC338Q_CLKGEN_BDMA>;
        #dma-cells = <2>;
    };
```

## Documentation/devicetree/bindings/i2c/sstar,ssc338q-i2c.yaml
```yaml
# SPDX-License-Identifier: (GPL-2.0-only OR BSD-2-Clause)
%YAML 1.2
---
$id: http://devicetree.org/schemas/i2c/sstar,ssc338q-i2c.yaml#
$schema: http://devicetree.org/meta-schemas/core.yaml#

title: SigmaStar SSC338Q I2C master

maintainers:
  - Petr Kracik <petrkr@petrkr.net>

description:
  The I2C master controllers (MIIC) of the SigmaStar SSC338Q (Infinity6E)
  SoC.

allOf:
  - $ref: /schemas/i2c/i2c-controller.yaml#

properties:
  compatible:
    const: sstar,ssc338q-i2c

  reg:
    maxItems: 1

  clocks:
    maxItems: 1

  clock-frequency:
    default: 100000

required:
  - compatible
  - reg
  - clocks

unevaluatedProperties: false

examples:
  - |
    #include <dt-bindings/clock/sstar,ssc338q-clkgen.h>

    i2c@223000 {
        compatible = "sstar,ssc338q-i2c";
        reg = <0x223000 0x200>;
        clocks = <&clkgen SSC338Q_CLKGEN_MIIC0>;
        #address-cells = <1>;
        #size-cells = <0>;
    };
```

## Documentation/devicetree/bindings/iio/adc/sstar,ssc338q-sar-adc.yaml
```yaml
# SPDX-License-Identifier: (GPL-2.0-only OR BSD-2-Clause)
%YAML 1.2
---
$id: http://devicetree.org/schemas/iio/adc/sstar,ssc338q-sar-adc.yaml#
$schema: http://devicetree.org/meta-schemas/core.yaml#

title: SigmaStar SSC338Q SAR ADC

maintainers:
  - Petr Kracik <petrkr@petrkr.net>

description:
  The 10-bit SAR ADC with four inputs in the PM domain of the SigmaStar
  SSC338Q (Infinity6E) SoC. Its clock comes from the PM sleep block and is
  enabled at reset. The block also holds the mode and GPIO state of the
  input pads, which the pin controller accesses as a system controller.

  The ADC also measures the on-chip temperature sensor, which is powered
  from the PM sleep block and calibrated with a value from the OTP.

properties:
  compatible:
    items:
      - const: sstar,ssc338q-sar-adc
      - const: syscon

  reg:
    maxItems: 1

  "#io-channel-cells":
    const: 1
    description:
      Channels 0 to 3 are the inputs, channel 4 is the temperature sensor.

  nvmem-cells:
    items:
      - description: Temperature sensor reading at 27 degrees Celsius

  nvmem-cell-names:
    items:
      - const: ts-calib

  sstar,pmsleep:
    $ref: /schemas/types.yaml#/definitions/phandle
    description: PM sleep block with the power control of the temperature
      sensor

dependencies:
  sstar,pmsleep: [ nvmem-cells ]
  nvmem-cells: [ sstar,pmsleep ]

required:
  - compatible
  - reg

additionalProperties: false

examples:
  - |
    adc@2800 {
        compatible = "sstar,ssc338q-sar-adc", "syscon";
        reg = <0x2800 0x200>;
        #io-channel-cells = <1>;
        nvmem-cells = <&otp_ts_calib>;
        nvmem-cell-names = "ts-calib";
        sstar,pmsleep = <&pmsleep>;
    };
```

## Documentation/devicetree/bindings/mmc/sstar,ssc338q-fcie.yaml
```yaml
# SPDX-License-Identifier: (GPL-2.0-only OR BSD-2-Clause)
%YAML 1.2
---
$id: http://devicetree.org/schemas/mmc/sstar,ssc338q-fcie.yaml#
$schema: http://devicetree.org/meta-schemas/core.yaml#

title: SigmaStar SSC338Q FCIE SD host controller

maintainers:
  - Petr Kracik <petrkr@petrkr.net>

description:
  The FCIE (flash card interface engine) of the SigmaStar SSC338Q
  (Infinity6E) SoC is an SD host controller with its own DMA engine.

allOf:
  - $ref: mmc-controller.yaml#

properties:
  compatible:
    const: sstar,ssc338q-fcie

  reg:
    maxItems: 1

  interrupts:
    maxItems: 1

  clocks:
    maxItems: 1

required:
  - compatible
  - reg
  - interrupts
  - clocks

unevaluatedProperties: false

examples:
  - |
    #include <dt-bindings/clock/sstar,ssc338q-clkgen.h>
    #include <dt-bindings/interrupt-controller/arm-gic.h>

    mmc@282600 {
        compatible = "sstar,ssc338q-fcie";
        reg = <0x282600 0x100>;
        interrupts = <GIC_SPI 18 IRQ_TYPE_LEVEL_HIGH>;
        clocks = <&clkgen SSC338Q_CLKGEN_SD>;
        bus-width = <4>;
    };
```

## Documentation/devicetree/bindings/nvmem/sstar,ssc338q-otp.yaml
```yaml
# SPDX-License-Identifier: (GPL-2.0-only OR BSD-2-Clause)
%YAML 1.2
---
$id: http://devicetree.org/schemas/nvmem/sstar,ssc338q-otp.yaml#
$schema: http://devicetree.org/meta-schemas/core.yaml#

title: SigmaStar SSC338Q OTP

maintainers:
  - Petr Kracik <petrkr@petrkr.net>

description:
  One-time programmable memory of the SigmaStar SSC338Q (Infinity6E) SoC.
  The fuse words are mirrored in a bank of 16-bit registers, one word per
  32-bit register. They hold the chip ID and factory calibration data.

allOf:
  - $ref: nvmem.yaml#

properties:
  compatible:
    const: sstar,ssc338q-otp

  reg:
    maxItems: 1

required:
  - compatible
  - reg

unevaluatedProperties: false

examples:
  - |
    efuse@203000 {
        compatible = "sstar,ssc338q-otp";
        reg = <0x203000 0x200>;

        nvmem-layout {
            compatible = "fixed-layout";
            #address-cells = <1>;
            #size-cells = <1>;

            chip-id@a8 {
                reg = <0xa8 0x6>;
            };
        };
    };
```

## Documentation/devicetree/bindings/phy/sstar,ssc338q-usb2-phy.yaml
```yaml
# SPDX-License-Identifier: (GPL-2.0-only OR BSD-2-Clause)
%YAML 1.2
---
$id: http://devicetree.org/schemas/phy/sstar,ssc338q-usb2-phy.yaml#
$schema: http://devicetree.org/meta-schemas/core.yaml#

title: SigmaStar SSC338Q USB 2.0 PHY

maintainers:
  - Petr Kracik <petrkr@petrkr.net>

description:
  UTMI transceiver of the USB 2.0 host port, with the battery charger
  detection block on its data lines.

properties:
  compatible:
    const: sstar,ssc338q-usb2-phy

  reg:
    items:
      - description: UTMI registers
      - description: Battery charger detection registers

  reg-names:
    items:
      - const: utmi
      - const: bc

  "#phy-cells":
    const: 0

required:
  - compatible
  - reg
  - reg-names
  - "#phy-cells"

additionalProperties: false

examples:
  - |
    phy@284200 {
        compatible = "sstar,ssc338q-usb2-phy";
        reg = <0x284200 0x200>, <0x284400 0x200>;
        reg-names = "utmi", "bc";
        #phy-cells = <0>;
    };
```
